## lib/Kconfig
```kconfig
config AMPOULE
    bool "Enables the ampoule library"
    default n
    select RING_BUFFER
    select AMPOULE_PROTOS

DT_CHOSEN_AMP_SERIAL := ampoule,transport-serial

config AMPOULE_TRANSPORT_SERIAL
	bool "Serial backend"
	default "$(dt_chosen_enabled,$(DT_CHOSEN_AMP_SERIAL))" if HAS_DTS
	default y if !HAS_DTS
	select SERIAL
	select RING_BUFFER
	help
	  Enable serial backend.
```

## tests/command/testcase.yaml
```yaml
common:
  platform_allow:
    - qemu_x86
    - native_sim
    - nrf52840dk/nrf52840
  tags: command
tests:
  command.host: {}
```

## tests/hil/testcase.yaml
```yaml
tests:
  hil.ingestion:
    platform_allow: nrf52840dk/nrf52840
    harness: pytest
```

## tests/ingestion/testcase.yaml
```yaml
tests:
  ingestion.host:
    platform_allow: qemu_x86 native_sim
    tags: ingestion
```

## west.yml
```yaml
manifest:
  group-filter:
    - +optional
  remotes:
    - name: zephyrproject-rtos
      url-base: https://github.com/zephyrproject-rtos
    - name: ldenefle
      url-base: https://github.com/ldenefle

  projects:
    - name: zephyr
      remote: zephyrproject-rtos
      revision: v4.0.0
      import:
        name-allowlist:
          - cmsis
          - nanopb
          - hal_rpi_pico
          - hal_nordic
    - name: ampoule-protos
      remote: ldenefle
      revision: main
      path: modules/lib/ampoule-protos
```
