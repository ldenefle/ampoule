## CMakeLists.txt
```
cmake_minimum_required(VERSION 3.20.0)

find_package(Zephyr HINTS $ENV{ZEPHYR_BASE})
project(transport)

FILE(GLOB app_sources src/*.c)
target_sources(app PRIVATE ${app_sources})
```

## sample.yaml
```
sample:
  description: Demonstration of the converge transport layer
  name: Transport sample
tests:
  sample.subsys.transport:
    tags: transport
    filter: CONFIG_SERIAL and
            CONFIG_UART_INTERRUPT_DRIVEN and
            dt_chosen_enabled("ampoule,transport-serial")
```

## prj.conf
```kconfig
CONFIG_AMPOULE=y
CONFIG_SYSTEM_WORKQUEUE_STACK_SIZE=4096
```

## boards/nrf52840dk_nrf52840.overlay
```dts
/ {
	chosen {
		ampoule,transport-serial = &uart0;
	};
};
```

## src/main.c
```c
int main(void){
    return 0;
}
```
